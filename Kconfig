## Kconfig
```kconfig
menu "ESP-SoftAP Configuration"

config ESP_SOFTAP_SSID
        string "WiFi SSID"
        default "myssid"
        help
            The SSID of your access point.

    config ESP_SOFTAP_PASSWORD
        string "WiFi Password"
        default "mypassword"
        help
            WiFi password of your access point.

    config ESP_SOFTAP_CHANNEL
        int "WiFi Channel"
        range 1 13
        default 1
        help
            WiFi channel of your access point.

    config ESP_SOFTAP_MAX_STA_CONN
        int "Maximum connected Stations"
        default 4
        help
            Max number of stations that can connect to your access point simultaneously.
            
endmenu
```
